## dts/bindings/joystick/nam-joystick.yaml
```yaml
description: joystick driver
compatible: "nam-joystick"

include: base.yaml

properties:
  polling-interval-ms:
    type: int
    default: 100
    description: Interval between two reads, in ms.
```

## modules/drivers/joystick/Kconfig
```kconfig
config JOYSTICK
    bool "joystick driver"
    depends on ADC
    depends on INPUT
    help
      Enable Joystick driver implementation.
```

## modules/usb_class/Kconfig
```kconfig
config USB_CUSTOM_CLASS
    bool "Custom Vendor USB Class"
    depends on USB_DEVICE_STACK_NEXT
    depends on NET_BUF
    help
      Enable custom vendor USB class implementation.
      Provides bulk endpoints for bidirectional communication.
```
